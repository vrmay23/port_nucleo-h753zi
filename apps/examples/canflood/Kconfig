## apps/examples/canflood/Kconfig
```kconfig
#
# For a description of the syntax of this configuration file,
# see the file kconfig-language.txt in the NuttX tools repository.
#

config EXAMPLES_CANFLOOD
	tristate "CAN Flood Test Application"
	default n
	depends on NET_CAN
	---help---
		Enable the CAN flood test application. This application sends
		random CAN frames with random IDs at a configurable rate.
		Supports both standard (11-bit) and extended (29-bit) CAN IDs.

if EXAMPLES_CANFLOOD

config EXAMPLES_CANFLOOD_PROGNAME
	string "Program name"
	default "canflood"
	---help---
		This is the name of the program that will be used when the
		NSH ELF program is installed.

config EXAMPLES_CANFLOOD_PRIORITY
	int "canflood task priority"
	default 100

config EXAMPLES_CANFLOOD_STACKSIZE
	int "canflood stack size"
	default 4096

endif # EXAMPLES_CANFLOOD
```

## apps/examples/lcd_battery/Kconfig
```kconfig
#
# For a description of the syntax of this configuration file,
# see the file kconfig-language.txt in the NuttX tools repository.
#
config EXAMPLES_LCD_BATTERY
	bool "LCD Battery Demo for SSD1306"
	default n
	depends on LCD && LCD_DEV
	---help---
        Enable LCD Battery Demo that shows a battery icon draining
        from 100% to 0% on SSD1306 OLED display via /dev/lcd0.
        When battery reaches 0%, displays "NuttX" inside the battery.

config EXAMPLES_LCD_BATTERY_PROGNAME
	string "Program name"
	default "lcd_battery"
	depends on EXAMPLES_LCD_BATTERY

config EXAMPLES_LCD_BATTERY_PRIORITY
	int "LCD Battery task priority"
	default 100
	depends on EXAMPLES_LCD_BATTERY

config EXAMPLES_LCD_BATTERY_STACKSIZE
	int "LCD Battery stack size"
	default DEFAULT_TASK_STACKSIZE
	depends on EXAMPLES_LCD_BATTERY
```

## nuttx-spi-enhanced-working/boards/arm/stm32h7/nucleo-h753zi/Kconfig.old
```kconfig
#
# For a description of the syntax of this configuration file,
# see the file kconfig-language.txt in the NuttX tools repository.
#

if ARCH_BOARD_NUCLEO_H753ZI

config STM32_ROMFS
	bool "Automount built-in ROMFS image"
	default n
	depends on FS_ROMFS
	---help---
		Select STM32_ROMFS_IMAGEFILE, STM32_ROMFS_DEV_MINOR, STM32_ROMFS_MOUNTPOINT

config STM32_ROMFS_DEV_MINOR
	int "Minor number for the block device backing the data"
	depends on STM32_ROMFS
	default 64

config STM32_ROMFS_MOUNTPOINT
	string "Mount point of the custom ROMFS image"
	depends on STM32_ROMFS
	default "/rom"

config STM32_ROMFS_IMAGEFILE
	string "ROMFS image file to include in the build"
	depends on STM32_ROMFS
	default "../../../rom.img"

#
# HSE source
#

choice
	prompt "HSE clock source"
	default BOARD_HSE_SOURCE_STLINK
	---help---
		Select the source for the High Speed External (HSE) clock.
		This choice determines the solder bridge configuration needed
		on the Nucleo-H753ZI board.

config BOARD_HSE_SOURCE_STLINK
	bool "ST-LINK MCO 8 MHz (default Nucleo)"
	---help---
		Default configuration for Nucleo-H753ZI.
		Uses 8 MHz MCO output from ST-LINK.
		
		Solder Bridge Configuration:
		SB45=ON, SB44=OFF, SB46=OFF, SB3=OFF, SB4=OFF.
		
		This is the factory default configuration and requires
		no hardware modifications.

config BOARD_HSE_SOURCE_X3
	bool "External crystal X3"
	---help---
		Uses external crystal connected to X3 footprint.
		Supports various crystal frequencies (8-25 MHz).
		
		Solder Bridge Configuration:
		SB3=ON, SB4=ON, SB45=OFF, SB44=OFF, SB46=OFF.
		
		You must solder a crystal to the X3 footprint and
		configure the solder bridges as indicated.

endchoice

config BOARD_HSE_X3_FREQ
	int "X3 crystal frequency (Hz)"
	depends on BOARD_HSE_SOURCE_X3
	default 25000000
	range 8000000 25000000
	---help---
		Frequency of the external crystal X3.
		
		Supported frequencies:
		- 8000000  (8 MHz)
		- 12000000 (12 MHz) 
		- 16000000 (16 MHz)
		- 20000000 (20 MHz)
		- 24000000 (24 MHz)
		- 25000000 (25 MHz)
		
		The PLL configuration will be automatically adjusted
		to maintain 400 MHz SYSCLK regardless of the chosen
		HSE frequency.

#
# Board-specific GPIO Driver
#
config NUCLEO_H753ZI_GPIO_DRIVER
	bool "Enable Nucleo H753ZI board GPIO driver"
	default n
	select DEV_GPIO
	---help---
		This option enables the low-level GPIO driver for the Nucleo H753ZI
		board. Other features like buttons or LEDs will depend on this
		driver.

#
# LEDs Configuration
#

choice
	prompt "LED Control Mode"
	default NUCLEO_H753ZI_LEDS_AUTO
	---help---
		Select how the onboard LEDs should be controlled.

config NUCLEO_H753ZI_LEDS_AUTO
	bool "Automatic LEDs (Kernel controlled)"
	---help---
		LEDs are automatically controlled by the kernel to indicate
		system status (boot stages, interrupts, panics, etc.).
		The LEDs will show:
		- GREEN: System ready, signals
		- ORANGE: Heap allocation, IRQs  
		- RED: Assertions, panics, idle
		
		NOTE: You still need to manually enable:
		Board Selection → Board LED Status support

config NUCLEO_H753ZI_LEDS_USER
	bool "User-controlled LEDs"
	select USERLED
	select USERLED_LOWER
	select BOARD_LATE_INITIALIZE
	---help---
		LEDs are controlled by user applications via /dev/userleds.
		Applications can turn individual LEDs on/off as needed.
		Kernel status indication is disabled.
		
		NOTE: You must manually disable:
		Board Selection → Board LED Status support (to avoid conflicts)

config NUCLEO_H753ZI_LEDS_DISABLED
	bool "LEDs disabled"
	---help---
		LED functionality is completely disabled to save resources.
		
		NOTE: You should manually disable:
		Board Selection → Board LED Status support

endchoice


#
# Button Configuration
#

menu "Button Configuration"

config NUCLEO_H753ZI_BUTTON_SUPPORT
	bool "Enable button support"
	default n
	#depends on NUCLEO_H753ZI_GPIO_DRIVER
	select ARCH_BUTTONS
	---help---
		Enable GPIO button support for the Nucleo-H753ZI board.

config NUCLEO_H753ZI_BUTTON_COUNT
	int "Number of buttons"
	depends on NUCLEO_H753ZI_BUTTON_SUPPORT
	default 1
	range 1 32
	---help---
		Total number of buttons to configure (1-32).
		
		The STM32H7 button driver supports up to 32 buttons using
		a 32-bit bitmask for button states.

config NUCLEO_H753ZI_BUTTON_BUILTIN
	bool "Include built-in user button (PC13)"
	depends on NUCLEO_H753ZI_BUTTON_SUPPORT
	default y
	---help---
		Include the built-in blue user button connected to PC13.
		This button will always be assigned as button index 0.
		
		If enabled, you need (BUTTON_COUNT - 1) additional pins.
		If disabled, you need exactly BUTTON_COUNT pins.

config NUCLEO_H753ZI_BUTTON_PINS
	string "Button GPIO pin list"
	depends on NUCLEO_H753ZI_BUTTON_SUPPORT
	default ""
	---help---
		Comma-separated list of GPIO pins for buttons.
		
		Format: PORT+PIN (e.g., "PF15,PG14,PG9,PE0,PA0,PB12")
		
		Number of pins required:
		- With built-in: (BUTTON_COUNT - 1) pins
		- Without built-in: BUTTON_COUNT pins
		
		Example for 5 buttons with built-in enabled:
		"PF15,PG14,PG9,PE0"
		
		Common Nucleo-H753ZI pins:
		Arduino Headers: PF15(D2), PG14(D1), PG9(D0), PE0(D34)
		Morpho Headers: PA0-PA15, PB0-PB15, PC0-PC15, PD0-PD15,
		               PE0-PE15, PF0-PF15, PG0-PG15, PH0-PH1
		
		Note: All buttons assume pull-down resistor configuration.

config NUCLEO_H753ZI_BUTTON_VALIDATION
	bool "Validate pin configuration at compile time"
	depends on NUCLEO_H753ZI_BUTTON_SUPPORT
	default y
	---help---
		Perform compile-time validation of GPIO pin assignments.

endmenu

endif # ARCH_BOARD_NUCLEO_H753ZI
```
