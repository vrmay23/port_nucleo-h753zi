## nuttx/boards/arm/stm32h7/nucleo-h753zi/Kconfig.old
```kconfig
#
# For a description of the syntax of this configuration file,
# see the file kconfig-language.txt in the NuttX tools repository.
#
if ARCH_BOARD_NUCLEO_H753ZI
config STM32_ROMFS
	bool "Automount built-in ROMFS image"
	default n
	depends on FS_ROMFS
	---help---
		Select STM32_ROMFS_IMAGEFILE, STM32_ROMFS_DEV_MINOR, STM32_ROMFS_MOUNTPOINT
config STM32_ROMFS_DEV_MINOR
	int "Minor number for the block device backing the data"
	depends on STM32_ROMFS
	default 64
config STM32_ROMFS_MOUNTPOINT
	string "Mount point of the custom ROMFS image"
	depends on STM32_ROMFS
	default "/rom"
config STM32_ROMFS_IMAGEFILE
	string "ROMFS image file to include in the build"
	depends on STM32_ROMFS
	default "../../../rom.img"
#
# LEDs Configuration
#
choice
	prompt "LED Control Mode"
	default NUCLEO_H753ZI_LEDS_AUTO
	---help---
		Select how the onboard LEDs should be controlled.
config NUCLEO_H753ZI_LEDS_AUTO
	bool "Automatic LEDs (Kernel controlled)"
	---help---
		LEDs are automatically controlled by the kernel to indicate
		system status (boot stages, interrupts, panics, etc.).
		The LEDs will show:
		- GREEN: System ready, signals
		- ORANGE: Heap allocation, IRQs  
		- RED: Assertions, panics, idle
		
		NOTE: You still need to manually enable:
		Board Selection → Board LED Status support
config NUCLEO_H753ZI_LEDS_USER
	bool "User-controlled LEDs"
	select USERLED
	select USERLED_LOWER
	select BOARD_LATE_INITIALIZE
	---help---
		LEDs are controlled by user applications via /dev/userleds.
		Applications can turn individual LEDs on/off as needed.
		Kernel status indication is disabled.
		
		NOTE: You must manually disable:
		Board Selection → Board LED Status support (to avoid conflicts)
config NUCLEO_H753ZI_LEDS_DISABLED
	bool "LEDs disabled"
	---help---
		LED functionality is completely disabled to save resources.
		
		NOTE: You should manually disable:
		Board Selection → Board LED Status support
endchoice

#
# HSE source
#
choice
	prompt "HSE clock source"
	default BOARD_HSE_SOURCE_STLINK
	---help---
		Select the source for the High Speed External (HSE) clock.
		This choice determines the solder bridge configuration needed
		on the Nucleo-H753ZI board.

config BOARD_HSE_SOURCE_STLINK
	bool "ST-LINK MCO 8 MHz (default Nucleo)"
	---help---
		Default configuration for Nucleo-H753ZI.
		Uses 8 MHz MCO output from ST-LINK.
		
		Solder Bridge Configuration:
		SB45=ON, SB44=OFF, SB46=OFF, SB3=OFF, SB4=OFF.
		
		This is the factory default configuration and requires
		no hardware modifications.

config BOARD_HSE_SOURCE_X3
	bool "External crystal X3"
	---help---
		Uses external crystal connected to X3 footprint.
		Supports various crystal frequencies (8-25 MHz).
		
		Solder Bridge Configuration:
		SB3=ON, SB4=ON, SB45=OFF, SB44=OFF, SB46=OFF.
		
		You must solder a crystal to the X3 footprint and
		configure the solder bridges as indicated.

endchoice

config BOARD_HSE_X3_FREQ
	int "X3 crystal frequency (Hz)"
	depends on BOARD_HSE_SOURCE_X3
	default 25000000
	range 8000000 25000000
	---help---
		Frequency of the external crystal X3.
		
		Supported frequencies:
		- 8000000  (8 MHz)
		- 12000000 (12 MHz) 
		- 16000000 (16 MHz)
		- 20000000 (20 MHz)
		- 24000000 (24 MHz)
		- 25000000 (25 MHz)
		
		The PLL configuration will be automatically adjusted
		to maintain 400 MHz SYSCLK regardless of the chosen
		HSE frequency.

endif # ARCH_BOARD_NUCLEO_H753ZI
```
