## apps/examples/bev_cluster/Kconfig
```kconfig
#
# For a description of the syntax of this configuration file,
# see the file kconfig-language.txt in the NuttX tools repository.
#

config EXAMPLES_BEV_CLUSTER
	tristate "BEV Cluster Application"
	default n
	depends on GRAPHICS_LVGL
	select LIBC_FLOATINGPOINT
	---help---
		Enable the BEV (Battery Electric Vehicle) Cluster application.
		This application provides a complete instrument cluster with:
		- CAN bus integration (10 message/signal placeholders)
		- LVGL graphical display (speed, battery, power, temp, direction)
		- Button handling (auto-detects from board config)
		- Notification system (permanent + 5s timeout)

		Requirements:
		- GRAPHICS_LVGL=y (Graphics library with framebuffer)
		- Optional: CAN support (SocketCAN)
		- Optional: Button driver (/dev/buttons)

if EXAMPLES_BEV_CLUSTER

config EXAMPLES_BEV_CLUSTER_PROGNAME
	string "Program name"
	default "bev_cluster"
	---help---
		This is the name of the program that will be used when the NSH ELF
		program is installed.

config EXAMPLES_BEV_CLUSTER_PRIORITY
	int "BEV Cluster task priority"
	default 100

config EXAMPLES_BEV_CLUSTER_STACKSIZE
	int "BEV Cluster stack size"
	default 8192
	---help---
		Stack size for the BEV Cluster application.
		8192 bytes is recommended for LVGL + CAN + buttons.

endif
```

## apps/examples/buttons/Kconfig
```kconfig
#
# For a description of the syntax of this configuration file,
# see the file kconfig-language.txt in the NuttX tools repository.
#

config EXAMPLES_BUTTONS
	tristate "Buttons driver example"
	default n
	depends on INPUT_BUTTONS
	---help---
		Enable the Buttons drivers example

if EXAMPLES_BUTTONS

config EXAMPLES_BUTTONS_PROGNAME
	string "Program name"
	default "buttons"
	---help---
		This is the name of the program that will be used when the NSH ELF
		program is installed.

config EXAMPLES_BUTTONS_PRIORITY
	int "Button task priority"
	default 100

config EXAMPLES_BUTTONS_STACKSIZE
	int "Button stack size"
	default DEFAULT_TASK_STACKSIZE

config EXAMPLES_BUTTONS_DEVPATH
	string "Button device path"
	default "/dev/buttons"

config EXAMPLES_BUTTONS_NAMES
	bool "Show Buttons Names"
	default n
	---help---
		Enable to show the button's name in the application.

choice
	prompt "Notification mechanism"
	default EXAMPLES_BUTTONS_SIGNAL

config EXAMPLES_BUTTONS_SIGNAL
	bool "Notify using signals"

config EXAMPLES_BUTTONS_POLL
	bool "Notify using poll()"

endchoice

if EXAMPLES_BUTTONS_NAMES

config EXAMPLES_BUTTONS_QTD
	int "Number of Buttons in the Board"
	default 8

config EXAMPLES_BUTTONS_NAME0
	string "Button 0 Name"
	default "BUTTON0"

config EXAMPLES_BUTTONS_NAME1
	string "Button 1 Name"
	default "BUTTON1"

config EXAMPLES_BUTTONS_NAME2
	string "Button 2 Name"
	default "BUTTON2"

config EXAMPLES_BUTTONS_NAME3
	string "Button 3 Name"
	default "BUTTON3"

config EXAMPLES_BUTTONS_NAME4
	string "Button 4 Name"
	default "BUTTON4"

config EXAMPLES_BUTTONS_NAME5
	string "Button 5 Name"
	default "BUTTON5"

config EXAMPLES_BUTTONS_NAME6
	string "Button 6 Name"
	default "BUTTON6"

config EXAMPLES_BUTTONS_NAME7
	string "Button 7 Name"
	default "BUTTON7"

config EXAMPLES_BUTTONS_NAME8
	string "Button 8 Name"
	default "BUTTON8"

config EXAMPLES_BUTTONS_NAME9
	string "Button 9 Name"
	default "BUTTON9"

config EXAMPLES_BUTTONS_NAME10
	string "Button 10 Name"
	default "BUTTON10"

config EXAMPLES_BUTTONS_NAME11
	string "Button 11 Name"
	default "BUTTON11"

config EXAMPLES_BUTTONS_NAME12
	string "Button 12 Name"
	default "BUTTON12"

config EXAMPLES_BUTTONS_NAME13
	string "Button 13 Name"
	default "BUTTON13"

config EXAMPLES_BUTTONS_NAME14
	string "Button 14 Name"
	default "BUTTON14"

config EXAMPLES_BUTTONS_NAME15
	string "Button 15 Name"
	default "BUTTON15"
	
config EXAMPLES_BUTTONS_NAME16
	string "Button 16 Name"
	default "BUTTON16"

config EXAMPLES_BUTTONS_NAME17
	string "Button 17 Name"
	default "BUTTON17"

config EXAMPLES_BUTTONS_NAME18
	string "Button 18 Name"
	default "BUTTON18"

config EXAMPLES_BUTTONS_NAME19
	string "Button 19 Name"
	default "BUTTON19"

config EXAMPLES_BUTTONS_NAME20
	string "Button 20 Name"
	default "BUTTON20"

config EXAMPLES_BUTTONS_NAME21
	string "Button 21 Name"
	default "BUTTON21"

config EXAMPLES_BUTTONS_NAME22
	string "Button22 Name"
	default "BUTTON22"

config EXAMPLES_BUTTONS_NAME23
	string "Button 23 Name"
	default "BUTTON23"

config EXAMPLES_BUTTONS_NAME24
	string "Button 24 Name"
	default "BUTTON24"

config EXAMPLES_BUTTONS_NAME25
	string "Button 25 Name"
	default "BUTTON25"

config EXAMPLES_BUTTONS_NAME26
	string "Button 26 Name"
	default "BUTTON26"

config EXAMPLES_BUTTONS_NAME27
	string "Button 27 Name"
	default "BUTTON27"

config EXAMPLES_BUTTONS_NAME28
	string "Button 28 Name"
	default "BUTTON28"

config EXAMPLES_BUTTONS_NAME29
	string "Button 29 Name"
	default "BUTTON29"

config EXAMPLES_BUTTONS_NAME30
	string "Button 30 Name"
	default "BUTTON30"
	
config EXAMPLES_BUTTONS_NAME31
	string "Button 31 Name"
	default "BUTTON31"
	
endif # EXAMPLES_BUTTONS_NAMES
endif # EXAMPLES_BUTTONS
```

## apps/examples/lvgl_my_photo/Kconfig
```kconfig
config EXAMPLES_LVGL_MY_PHOTO
    tristate "LVGL My Photo Example"
    default n
    depends on GRAPHICS_LVGL
    ---help---
        Enable LVGL photo display example

if EXAMPLES_LVGL_MY_PHOTO

config EXAMPLES_LVGL_MY_PHOTO_PROGNAME
    string "Program name"
    default "myphoto"

config EXAMPLES_LVGL_MY_PHOTO_PRIORITY
    int "Task priority"
    default 100

config EXAMPLES_LVGL_MY_PHOTO_STACKSIZE
    int "Stack size"
    default 8192

endif
```

## apps/taskmgr/Kconfig
```kconfig
config TASKMGR
    bool "Task Manager (nuttPID)"
    default n
    depends on NSH_LIBRARY
    ---help---
        Task Manager utility to list and control tasks (similar to pidin).
```

## apps/tgtestapps/tgtest/Kconfig
```kconfig
config TGTEST_APPS_TGTEST
        tristate "Tgtest App"
        default n
        ---help---
                Enable the Tgtest App

if TGTEST_APPS_TGTEST

config TGTEST_APPS_TGTEST_PROGNAME
        string "Program name"
        default "tgtest_app"
        ---help---
                This is the name of the program that will be used when the NSH ELF
                program is installed.

config TGTEST_APPS_TGTEST_PRIORITY
        int "tgtest task priority"
        default 100

config TGTEST_APPS_TGTEST_STACKSIZE
        int "Custom Hello stack size"
        default DEFAULT_TASK_STACKSIZE
endif
```
